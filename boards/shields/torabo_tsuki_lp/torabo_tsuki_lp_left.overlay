#include "torabo_tsuki_lp.dtsi"
#include <input/processors.dtsi>
#include <dt-bindings/zmk/input_transform.h>

&pointing_listener {
    input-processors = <&zip_xy_transform (INPUT_TRANSFORM_X_INVERT | INPUT_TRANSFORM_Y_INVERT)>,
                       <&zip_temp_layer 4 1000>;
};

// Auto mouse layer: keep layer 4 active while pressing clicks (J/K/L) or modifiers
&zip_temp_layer {
    require-prior-idle-ms = <300>;
    excluded-positions = <25 26 27 28 33 34 35 38 39 51 52 53 54 55>;
};